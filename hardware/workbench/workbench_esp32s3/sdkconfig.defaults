## hardware/workbench/workbench_esp32s3/sdkconfig.defaults
```kconfig
# Built against the same ESP-IDF release used for the DUT's MicroPython
# firmware (see vsdk/Makefile's VOOM_MICROPYTHON_IDF_PATH). Run
# `idf.py set-target esp32s3` once before the first build if this file
# doesn't already carry a target in sdkconfig.

CONFIG_IDF_TARGET="esp32s3"

# Route the console to the native USB-Serial-JTAG -- the interface the PC
# actually opens over USB (/dev/ttyACM*, /dev/cu.usbmodem*). serial_bridge.c
# installs its driver and moves raw DUT UART bridge bytes over the same
# endpoint, interleaved with ESP_LOGx. (Using UART0 sent bridge bytes to
# unconnected GPIO43/44.) See serial_bridge.c and WORKBENCH.md.
CONFIG_ESP_CONSOLE_USB_SERIAL_JTAG=y

# Explicit partition table (see partitions.csv) so Wi-Fi provisioning can
# flash the NVS partition at a known offset without a full build first.
CONFIG_PARTITION_TABLE_CUSTOM=y
CONFIG_PARTITION_TABLE_CUSTOM_FILENAME="partitions.csv"

# hall_sim.c's two timers use ESP_TIMER_ISR dispatch so the simulated hall
# pulse's GPIO edge lands directly from the systimer alarm interrupt instead
# of after a FreeRTOS task-switch to the shared "esp_timer" task -- that
# task-dispatch hop was the dominant source of jitter in the pulse timing.
CONFIG_ESP_TIMER_SUPPORTS_ISR_DISPATCH_METHOD=y

# gpio_set_level() must be IRAM-resident for hall_sim.c's ISR-dispatched
# callbacks to safely call it: the systimer alarm interrupt is installed with
# ESP_INTR_FLAG_IRAM and can fire while flash cache is disabled (e.g. during
# an SPI flash/NVS write), so anything it calls must not live in flash.
CONFIG_GPIO_CTRL_FUNC_IN_IRAM=y

# Core 1 is reserved for led_capture.c's capture_task (SPI-slave servicing
# only, see its file comment) -- lwIP's TCPIP task defaults to "no affinity"
# and can float onto either core, and at CONFIG_LWIP_TCPIP_TASK_PRIO=18 it
# outranks capture_task's priority, so it was free to preempt capture_task on
# core 1 for as long as it had network work to do (telemetry_task's TCP
# sends, WiFi RX, mDNS), causing exactly the same kind of dropped-burst
# jitter the s_frame_mutex fix addressed for a different reason. Pin it to
# core 0, where WiFi's own task already defaults
# (ESP_WIFI_TASK_PINNED_TO_CORE_0) and where serial_bridge/telemetry are now
# explicitly pinned too.
CONFIG_LWIP_TCPIP_TASK_AFFINITY_CPU0=y

# Tried raising the default 5760-byte TCP send/receive window (up to one full
# frame_apa102 payload, 57600, and smaller intermediate steps down to 11520)
# to cut the ~10 ACK round trips/frame the default forces at this network's
# measured ~10ms RTT (window/RTT puts the ceiling around 5Mbps, matching the
# ~80ms/frame measured on real hardware at the default). Every value above
# 5760 was unreliable on real hardware, including 11520 on a repeat run after
# an earlier run at that same value worked cleanly for 20s/379 frames: send()
# started returning small nonzero counts on nearly every SO_SNDTIMEO-bounded
# attempt instead of completing, eventually tripping send_all()'s overall
# deadline and disconnecting. Consistent with lwIP running short of
# pbuf/segment pool capacity to actually back a larger window (which doesn't
# auto-scale with TCP_SND_BUF/TCP_WND on this build) -- but reproducing
# inconsistently even at the smaller sizes means it's not simply "bigger
# window = worse"; something about accumulated connection state may also be
# involved. Left at the stock default: reliable beats marginally faster but
# flaky. Revisit only alongside the matching MEMP_NUM_TCP_SEG/pbuf pool
# sizing and real headroom testing, not another blind bump.
```
